## final/main/Kconfig.projbuild
```kconfig
menu "Klipper JC4880P443"
    config PANEL_ORIENTATION_TEST
        bool "Compilar la prueba de orientacion sin aplicacion Klipper"
        default n
        help
            Para la aplicacion normal dejar desactivado. La prueba requiere
            desactivar Hosted/Wi-Fi y usar su configuracion respaldada.

    config PORTAL_CORE_HD
        bool "Reproducir núcleos HD desde microSD"
        depends on !PANEL_ORIENTATION_TEST
        default y
        help
            Carga animaciones HD desde microSD y conserva el núcleo
            integrado como respaldo cuando el clip no está disponible.
endmenu
```

## final/sdkconfig.defaults
```kconfig
# ESP32-P4 v1.3 / pre-v3: validated board profile.
CONFIG_IDF_TARGET="esp32p4"
CONFIG_ESP32P4_SELECTS_REV_LESS_V3=y
CONFIG_ESP32P4_REV_MIN_100=y
CONFIG_ESP_DEFAULT_CPU_FREQ_MHZ_360=y
# CONFIG_ESP_FORCE_400MHZ_ON_REV_LESS_V3 is not set
CONFIG_SPIRAM=y
CONFIG_SPIRAM_MODE_HEX=y
CONFIG_SPIRAM_SPEED_200M=y
CONFIG_SPIRAM_USE_MALLOC=y
CONFIG_SPIRAM_MEMTEST=y
CONFIG_ESPTOOLPY_FLASHMODE_QIO=y
CONFIG_ESPTOOLPY_FLASHFREQ_80M=y
CONFIG_ESPTOOLPY_FLASHSIZE_16MB=y
CONFIG_ESP_CONSOLE_USB_SERIAL_JTAG=y
CONFIG_ESP_CONSOLE_SECONDARY_NONE=y
CONFIG_LOG_DEFAULT_LEVEL_INFO=y
CONFIG_LCD_DSI_ISR_HANDLER_IN_IRAM=y
CONFIG_LV_CONF_SKIP=y
CONFIG_LV_COLOR_DEPTH_16=y
CONFIG_LV_USE_CLIB_MALLOC=y
CONFIG_LV_OS_NONE=y
CONFIG_LV_FONT_MONTSERRAT_20=y
CONFIG_LV_FONT_MONTSERRAT_28=y
CONFIG_LV_FONT_MONTSERRAT_16=y
CONFIG_LV_FONT_MONTSERRAT_48=y
CONFIG_LV_USE_LODEPNG=y
# CONFIG_LV_BUILD_EXAMPLES is not set
CONFIG_ESP_MAIN_TASK_STACK_SIZE=8192
# Resource telemetry uses existing per-core idle runtime counters (microseconds).
CONFIG_FREERTOS_USE_TRACE_FACILITY=y
CONFIG_FREERTOS_USE_STATS_FORMATTING_FUNCTIONS=y
CONFIG_FREERTOS_GENERATE_RUN_TIME_STATS=y
CONFIG_FREERTOS_RUN_TIME_STATS_USING_ESP_TIMER=y
# Keep NVS/phy offsets and enlarge only factory for PORTAL assets and services.
# CONFIG_PARTITION_TABLE_SINGLE_APP is not set
# CONFIG_PARTITION_TABLE_SINGLE_APP_LARGE is not set
CONFIG_PARTITION_TABLE_CUSTOM=y
CONFIG_PARTITION_TABLE_CUSTOM_FILENAME="partitions.csv"
CONFIG_ESP_WIFI_REMOTE_ENABLED=y
CONFIG_ESP_WIFI_REMOTE_LIBRARY_HOSTED=y
CONFIG_SLAVE_IDF_TARGET_ESP32C6=y
CONFIG_ESP_HOSTED_ENABLED=y
CONFIG_ESP_HOSTED_CP_TARGET_ESP32C6=y
CONFIG_ESP_HOSTED_P4_DEV_BOARD_NONE=y
CONFIG_ESP_HOSTED_SDIO_HOST_INTERFACE=y
CONFIG_ESP_HOSTED_SDIO_SLOT_1=y
CONFIG_ESP_HOSTED_SDIO_4_BIT_BUS=y
CONFIG_ESP_HOSTED_PRIV_SDIO_PIN_CLK_SLOT_1=18
CONFIG_ESP_HOSTED_PRIV_SDIO_PIN_CMD_SLOT_1=19
CONFIG_ESP_HOSTED_PRIV_SDIO_PIN_D0_SLOT_1=14
CONFIG_ESP_HOSTED_PRIV_SDIO_PIN_D1_4BIT_BUS_SLOT_1=15
CONFIG_ESP_HOSTED_PRIV_SDIO_PIN_D2_4BIT_BUS_SLOT_1=16
CONFIG_ESP_HOSTED_PRIV_SDIO_PIN_D3_4BIT_BUS_SLOT_1=17
CONFIG_ESP_HOSTED_SDIO_GPIO_RESET_SLAVE=54
CONFIG_ESP_HOSTED_SDIO_RESET_ACTIVE_HIGH=y
CONFIG_ESP_HOSTED_SDIO_CLOCK_FREQ_KHZ=5000
CONFIG_ESP_HOSTED_SDIO_OPTIMIZATION_RX_NONE=y
# CONFIG_ESP_HOSTED_SD_PWR_CTRL_LDO_INTERNAL_IO is not set
# CONFIG_ESP_HOSTED_HOST_RESTART_NO_COMMUNICATION_WITH_SLAVE is not set
# CONFIG_ESP_HOSTED_TRANSPORT_RESTART_ON_FAILURE is not set
# CONFIG_ESP_HOSTED_ENABLE_BT_NIMBLE is not set
# CONFIG_ESP_HOSTED_ENABLE_BT_BLUEDROID is not set
# CONFIG_BT_ENABLED is not set

# Use the existing GT911 new-driver I2C master bus for ES8311.
# CONFIG_CODEC_I2C_BACKWARD_COMPATIBLE is not set
```
